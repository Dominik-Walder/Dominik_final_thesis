entry &build_cfg &binary_file

local &DualPort
if version.build.base()>=45520.
  &DualPort="/DualPort"

system.reset
system.detect.cpu
system.option.watchdog off
system.up

; setup MMU for FLASH, RAM and peripheral access
mmu.set tlb1 0. 0xC0000580 0xFFE0000A 0xFFE0003F
mmu.set tlb1 1. 0xC0000700 0x00000020 0x0000003F
mmu.set tlb1 2. 0xC0000700 0x20000020 0x0000003F
mmu.set tlb1 3. 0xC0000480 0x40000028 0x4000003F
mmu.set tlb1 4. 0xC0000580 0xC3E0000A 0xC3E0003F

; Initialize internal SRAM
if (cpu()=="MPC5777C")
(
	data.set EA:0x40000000--0x4003FFFF %quad 0
)
else
(
  print %ERROR "Device "+cpu()+" not supported by this script."
  enddo
)

; Flash declaration
flash.reset

; Low address space
flash.create 1. 0x00000000--0x0000FFFF target quad 0x0000    ; Low Flash Block 0 (Data Flash)
flash.create 1. 0x00010000--0x0001FFFF target quad 0x0001    ; Low Flash Block 1 (Data Flash)

; Mid address space
flash.create 2. 0x00020000--0x0002FFFF target quad 0x0100    ; Mid Flash Block 0 (Data Flash)
flash.create 2. 0x00030000--0x0003FFFF target quad 0x0101    ; Mid Flash Block 1 (Data Flash)

; High address space
flash.create 3. 0x00600000--0x00603FFF NOP    quad 0x0200    ; High Flash Block 0 (CSE)
flash.create 3. 0x00604000--0x00607FFF NOP    quad 0x0201    ; High Flash Block 1 (CSE)

; Large address space
flash.create 4. 0x00800000--0x0083FFFF target quad 0x0300    ; Large Flash Block 0 (Boot)
flash.create 4. 0x00840000--0x0087FFFF target quad 0x0301    ; Large Flash Block 1 (Calibration)
flash.create 4. 0x00880000--0x008BFFFF target quad 0x0302    ; Large Flash Block 2 (Calibration)
flash.create 4. 0x008C0000--0x008FFFFF target quad 0x0303    ; Large Flash Block 3 (Calibration)
flash.create 4. 0x00900000--0x0093FFFF target quad 0x0304    ; Large Flash Block 4 (Calibration)
flash.create 4. 0x00940000--0x0097FFFF target quad 0x0305    ; Large Flash Block 5
flash.create 4. 0x00980000--0x009BFFFF target quad 0x0306    ; Large Flash Block 6
flash.create 4. 0x009C0000--0x009FFFFF target quad 0x0307    ; Large Flash Block 7
flash.create 4. 0x00A00000--0x00A3FFFF target quad 0x0308    ; Large Flash Block 8
flash.create 4. 0x00A40000--0x00A7FFFF target quad 0x0309    ; Large Flash Block 9
flash.create 4. 0x00A80000--0x00ABFFFF target quad 0x030A    ; Large Flash Block 10
flash.create 4. 0x00AC0000--0x00AFFFFF target quad 0x030B    ; Large Flash Block 11
flash.create 4. 0x00B00000--0x00B3FFFF target quad 0x030C    ; Large Flash Block 12
flash.create 4. 0x00B40000--0x00B7FFFF target quad 0x030D    ; Large Flash Block 13
flash.create 4. 0x00B80000--0x00BBFFFF target quad 0x030E    ; Large Flash Block 14
flash.create 4. 0x00BC0000--0x00BFFFFF target quad 0x030F    ; Large Flash Block 15
flash.create 4. 0x00C00000--0x00C3FFFF target quad 0x0310    ; Large Flash Block 16
flash.create 4. 0x00C40000--0x00C7FFFF target quad 0x0311    ; Large Flash Block 17
flash.create 4. 0x00C80000--0x00CBFFFF target quad 0x0312    ; Large Flash Block 18
flash.create 4. 0x00CC0000--0x00CFFFFF target quad 0x0313    ; Large Flash Block 19
flash.create 4. 0x00D00000--0x00D3FFFF target quad 0x0314    ; Large Flash Block 20
flash.create 4. 0x00D40000--0x00D7FFFF target quad 0x0315    ; Large Flash Block 21
flash.create 4. 0x00D80000--0x00DBFFFF target quad 0x0316    ; Large Flash Block 22
flash.create 4. 0x00DC0000--0x00DFFFFF target quad 0x0317    ; Large Flash Block 23
flash.create 4. 0x00E00000--0x00E3FFFF target quad 0x0318    ; Large Flash Block 24
flash.create 4. 0x00E40000--0x00E7FFFF target quad 0x0319    ; Large Flash Block 25
flash.create 4. 0x00E80000--0x00EBFFFF target quad 0x031A    ; Large Flash Block 26
flash.create 4. 0x00EC0000--0x00EFFFFF target quad 0x031B    ; Large Flash Block 27
flash.create 4. 0x00F00000--0x00F3FFFF target quad 0x031C    ; Large Flash Block 28
flash.create 4. 0x00F40000--0x00F7FFFF target quad 0x031D    ; Large Flash Block 29
flash.create 4. 0x00F80000--0x00FBFFFF target quad 0x031E    ; Large Flash Block 30
flash.create 4. 0x00FC0000--0x00FFFFFF target quad 0x031F    ; Large Flash Block 31

; UTEST address space
flash.create 6. 0x00400000--0x00403FFF target quad 0x0500 /OTP /INFO "UTEST"

; Overlay enabled mapping
flash.createalias 0x08A00000--0x08FFFFFF 0x00A00000   ; Small & medium flash blocks
flash.createalias 0x09000000--0x09FFFFFF 0x01000000   ; Large flash blocks

flash.target E:0x40000000 E:0x40004000 0x1000 ~~/demo/powerpc/flash/quad/c55fm5777c.bin /stacksize 0x0200 /DualPort

flash.reprogram all /erase
data.load.elf ./&build_cfg/&binary_file ;/verify
flash.reprogram.off

;mmu.set tlb1 0x0 0xC0000480 0x40000008 0x4000003F
;mmu.set tlb1 0x1 0x00000000 0x00000000 0x00000000
;mmu.set tlb1 0x2 0x00000000 0x00000000 0x00000000
;mmu.set tlb1 0x3 0x00000000 0x00000000 0x00000000
;mmu.set tlb1 0x4 0x00000000 0x00000000 0x00000000
;mmu.set tlb1 0x5 0x00000000 0x00000000 0x00000000

data.list
go main 

enddo
